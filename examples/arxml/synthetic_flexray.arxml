AUTOSAR XML (schema 00046)
package /FrTest
  flexray cluster MlbFR
    flexray physical channel ChannelA: channel-name=CHANNEL-A
      frame SpeedFrame: frame-length=16, flexray-absolutely-scheduled-timing=slot-id=15
        pdu SpeedPDU: length=4
          signal speed_kph: start 0, 16 bit
          signal status_flag: start 16, 1 bit
      frame TorqueFrame: frame-length=8, flexray-absolutely-scheduled-timing=slot-id=16
        pdu TorquePDU: length=2
          signal torque_nm: start 0, 16 bit
    flexray physical channel ChannelB: channel-name=CHANNEL-B
      frame SpeedFrame: frame-length=16, flexray-absolutely-scheduled-timing=slot-id=15
        carries pdu SpeedPDU: 
